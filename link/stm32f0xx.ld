

/* Linker script for STM32F031 */
FLASH_OFFSET_TMP = DEFINED(FLASH_OFFSET) ? FLASH_OFFSET : 0K;
FLASH_SIZE_TMP = DEFINED(FLASH_SIZE) ? FLASH_SIZE : 32K;

/* Specify the memory areas */
MEMORY
{
  RAM_CODE (rx)   : ORIGIN = 0x20000000, LENGTH = DEFINED(RAM_CODE_SIZE) ? RAM_CODE_SIZE : 512
  RAM_DATA (xrw)  : ORIGIN = 0x20000000 + LENGTH(RAM_CODE), LENGTH = DEFINED(RAM_SIZE) ? RAM_SIZE : 4K - LENGTH(RAM_CODE)
  FLASH (rx)      : ORIGIN = 0x08000000 + FLASH_OFFSET_TMP, LENGTH = FLASH_SIZE_TMP - FLASH_OFFSET_TMP
}

REGION_ALIAS("VECTOR_BASE", RAM_CODE)
/*REGION_ALIAS("VECTOR_BASE", FLASH)*/

INCLUDE "link/ldscript_gen.ld"
